## ingestion-service/conf/local.conf
```bitbake
local.doc.root = "./src/main/resources"
profiler_path_prefix = ""

server {
  http {
    port = ":8489"
  }
  thrift {
    port = ":8487"
  }
  admin {
    disable = true
  }
}

admin_secret_key = "12345678"
service_key = 12345678


db {


  ssdb {
    host = "ssdb"
    port = 8888
    timeout_in_ms = 60000
  }

  clickhouse {
    driver_class = "com.github.housepower.jdbc.ClickHouseDriver"
    url = "jdbc:clickhouse://clickhouse_server_di:9000"
    user = "default"
    password = ""
  }
}


caas {
  thrift {
    host = "user_profile"
    port = "8589"
    timeout_sec = 5
    client_id = "caas-client-from-ingestion-service"
  }
}
```

## job-worker/conf/local.conf
```bitbake
server {
  http {
    port = ":8081"
  }
  thrift {
    port = ":8084"
  }
  admin {
    disable = true
  }
}

database_config {
  mysql {
    url = "jdbc:mysql://localhost:3306"
    username = "root"
    password = "di@2020!"
  }
  clickhouse {
    url = "jdbc:clickhouse://localhost:9000"
    username = "default"
    password = ""
  }
  ssdb {
    host = "localhost"
    port = 8888
    timeout_in_ms = 60000
    db_name = "interact_scheduler_worker"
  }
}

clients {
  caas {
    thrift {
      host = "172.19.0.6"
      port = "8589"
      timeout_sec = 5
      client_id = "caas-client-from-job-worker"
    }
  }
  schema {
    thrift {
      host = "localhost"
      port = "8487"
      timeout_sec = 5
      client_id = "ingestion-service-from-job-worker"
    }
  }
  bi_service {
    thrift {
      host = "localhost"
      port = "8050"
      timeout_sec = 5
      client_id = "bi-service-from-job-worker"
    }
  }
  lake {
    thrift {
      host = "localhost"
      port = "8050"
      timeout_sec = 5
      client_id = "lake-service-from-common-backend-clients"
    }
  }
  hadoop_file {
    thrift {
      host = "localhost"
      port = "8051"
      timeout_sec = 5
      client_id = "hadoop-file-service-from-common-backend-clients"
    }
  }
  notification {
    thrift {
      host = "localhost"
      port = "9999"
      timeout_sec = 5
      client_id = "notification-service-from-common-backend-clients"
    }
  }
}

scheduler_host = "http://localhost:8080"

job_queue_size = 8

num_job_worker = 4

sleep_interval_ms = 5000

connection_timeout = 500

access_token = "job$cheduler@datainsider.co"

fake_data {
  database {
    default {
      name = "database_test"
    }
    marketing {
      name = "1001_xshop"
    }
  }
  table {
    default {
      name = "CHARACTER_SETS"
    }
    student {
      name = "student"
    }
    customers {
      name = "Customers"
    }
    orders {
      name = "Orders"
    }
    products {
      name = "Products"
    }
    gdp {
      name = "Gdp"
    }
    marketing {
      name = "marketing"
    }
  }
}

database_test {
  mysql {
    service_name = "mysql"
    service_port = 3306
    url = "jdbc:mysql://localhost:3306"
    username = "root"
    password = "di@2020!"
  }
  clickhouse {
    service_name = "clickhouse"
    http_interface_port = 8123
    native_interface_port = 9000
    url = "jdbc:clickhouse://localhost:9000"
    username = "default"
    password = ""
  }
  ssdb {
    service_name = ssdb
    port = 8888
  }
  oracle {
    url = "jdbc:oracle:thin:@//139.99.89.154:1521/ORCLCDB.localdomain"
    username = "TVC12"
    password = "di@123456"
  }
  postgres {
    service_name = "postgres"
    service_port = 5432
    url = "jdbc:postgresql://localhost:5432/postgres"
    username = "di"
    password = "di@2020!"
  }
  mssql {
    service_name = "mssql"
    service_port = 1433
    url = "jdbc:sqlserver://localhost:1433;databaseName=master"
    username = "sa"
    password = "di@2020!"
  }
  redshift {
    url = "jdbc:redshift://redshift-cluster-1.ccuehoxyhjvi.ap-southeast-1.redshift.amazonaws.com:5439/dev"
    username = "awsuser"
    password = "di_Admin2021"
  }
  mongodb {
      host = "cluster0.mhzgt.mongodb.net/myFirstDatabase?retryWrites=true&w=majority"
      username = "myUserAdmin"
      password = "di@2020!"
  }
  shopify {
    api_url = "https://dev-datainsider.myshopify.com/"
    access_token = "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"
    api_version = "2022-04"
  }
  coin_market_cap {
    api_key = "d33c2303-e619-48fd-a642-d79e807c1267"
  }
}

old_table_existing_time = 60000

google {
  gg_client_id = "360432349791-lmnna6js7j3hmhjq07elblc4pbau0odk.apps.googleusercontent.com"

  gg_client_secret = "c0edGMJf8DlN4rwWZEVmn6cH"

  server_encoded_url = "https://accounts.google.com/o/oauth2/token"

  redirect_uri = "http%3A%2F%2Flocalhost%3A8080&"

  read_timeout_ms = 300000

  connection_timeout_ms = 300000
}

kafka-hadoop-data-block-config {

  topic = "kafka-hadoop-data-block-dev"

  delay-poll = 100    // delay between polls. 100 millis
  delay-error = 5000  // when consume error, delay and retry. 5 seconds

  producer {
    bootstrap.servers = "localhost:29092"
    acks = "all"
    linger.ms = 1
  }

}

hadoop_destination {
  block_chunk_size = 100
  base_dir = "/data/db"
  trash_path = "/user/root/.Trash"
}

hadoop-writer {
  base_dir = "/data/db"
  local-file-writer {
    base_dir = "./tmp/hadoop"
    file_extension = "txt"
    max_file_size = 64 MB
    max_queue_size = 10000
    enqueue_timeout_ms = 100
  }
  hdfs {
    file_system = "hdfs://localhost:9009"
    app_name = "Spark-file-service"
    master = "local[2]"
    num_partitions = 1
  }
}

clickhouse-writer {
  local-file-writer {
    base_dir = "./tmp/clickhouse"
    file_extension = "json"
    max_file_size = 100 MB
    max_queue_size = 10000
    enqueue_timeout_ms = 100
  }
  clickhouse-config {
    host = "localhost"
    port = 9000
    username = "default"
    password = ""
    encryption {
      mode = "aes-256-gcm"
      key = "2f17958458160187530dcdbdc0ce892fb67a18100733ec35b0f713a5790b765d"
      iv = "d4fcb696b6e8e06b4a3cdc630e8176b7"
    }
  }
}

solana {
  max_queue_size = 100
}


coin_market_cap {
  host = "https://pro-api.coinmarketcap.com"
  query_size = 1000
}

amazon_s3_worker {
  sync_batch_size = 1000
  base_dir = "./tmp/s3"
  connection_timeout = 600000
  sample_bytes_for_preview = 1000000
}

shopify {
  retry_time_out_ms = 30000
  min_retry_time_delay_ms = 500
  max_retry_time_delay_ms = 1000
  client_id = "9b4559e98372cf771860a50f098f2012"
  client_secret = "a1e57e6aac0dda83b071975684b5fa4d"
}

google_ads_api {
  gg_client_id = "969057219172-r1iu7q1u7hd1rpavp7rd5vokkrlh7f9n.apps.googleusercontent.com"

  gg_client_secret = "DvNDPkEtnsFccbt7sJaSbTft"

  server_encoded_url = "https://accounts.google.com/o/oauth2/token"

  redirect_uri = "http%3A%2F%2Flocalhost%3A8080&"

  developer_token = "OZFgyoemjAsx-LD8nTo_1A"

  metadata_uri = "https://gaql-query-builder.uc.r.appspot.com/schemas/v12"

  batch_size = 1000

  default_start_time = "2019-01-01"
}


worker_v2 {
  write_batch_size = 5000
  report_interval_size = 100000
}

ga4 {
  batch_size = 10000
}

facebook_ads {
  app_id = "1371850590286877"
  app_secret = "27c4375073eeabebba910688aba028de"
  exchange_url = "https://graph.facebook.com/v15.0/oauth/access_token"
}

tiktok_ads {
  app_key =  "7174346320419766274"
  app_secret = "8310b721c1244d2b67d1991a6ecc74f8b33d5237"
  base_url ="https://sandbox-ads.tiktok.com/open_api/v1.3"
}
```
